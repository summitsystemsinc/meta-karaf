## conf/layer.conf
```bitbake
# We have a conf and classes directory, add to BBPATH
BBPATH := "${BBPATH}:${LAYERDIR}"

# We have a recipes directory containing both .bb and .bbappend files, add to BBFILES
BBFILES := "${BBFILES} ${LAYERDIR}/recipes/*/*.bb \
             ${LAYERDIR}/recipes/*/*.bbappend"

BBFILE_COLLECTIONS += "apache-karaf"
BBFILE_PATTERN_apache-karaf := "^${LAYERDIR}/"
BBFILE_PRIORITY_apache-karaf = "6"
```
